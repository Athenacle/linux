## arch/x86/Kconfig.wxc
```kconfig
menuconfig WXC_LINUX
    bool "WXC Modified Linux Kernel"
    depends on X86
    help
        WXC Person Changed Linux Kernel.

if WXC_LINUX
    config WXC_LINUX_PROC_DIRECTORY
        bool "Enable /proc/wxc directory"
        depends on PROC_FS
        help
            Create /proc/wxc directory for providing message.

    comment "Features"

    config WXC_LINUX_KEYBOARD_STAT
        tristate "Collect Keyboard Press/UnPress Statistic"
        depends on WXC_LINUX_PROC_DIRECTORY && INPUT_KEYBOARD && m
        help
            Collect Keyboard Press/UnPress Statistic Data. And Store into
            /proc/wxc/keyboard_stat

    comment "Features from third party"

    config WXC_LINUX_BBSWITCH_SUPPORT
        tristate "Enable BBSWITCH Support"
        depends on PCI && ACPI && ACPI_PCI_SLOT && MODULES &&  m
        select MODULE_UNLOAD
        help
            BBSWITCH is a kernel module which automatically detects the
            required ACPI calls for Optimus laptops.
            From: https://github.com/Bumblebee-Project/bbswitch/tree/develop
            Commit: 9dd227019aac8f125e04befa2c0b1bf0624be482
            Update: 17 July, 2017

endif
```
